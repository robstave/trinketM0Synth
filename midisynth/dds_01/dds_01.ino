
 

#include "avr/pgmspace.h"


PROGMEM  prog_uchar tri256[]  = {0x2, 0x4, 0x6, 0x8, 0xa, 0xc, 0xe, 0x10, 0x12, 0x14, 0x16, 0x18, 0x1a,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 0x2, 0x0};


PROGMEM  prog_uchar sine256[]  = {
  127, 130, 133, 136, 139, 143, 146, 149, 152, 155, 158, 161, 164, 167, 170, 173,
  176, 178, 181, 184, 187, 190, 192, 195, 198, 200, 203, 205, 208, 210, 212, 215,
  217, 219, 221, 223, 225, 227, 229, 231, 233, 234, 236, 238, 239, 240, 242, 243,
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  78,  81,  84,  87,  90,  93,  96,  99,  102, 105, 108, 111, 115, 118, 121, 124

};
 
// Fix Serial for SAMD
#if defined(ARDUINO_SAMD_ZERO) && defined(SERIAL_PORT_USBVIRTUAL)
// Required for Serial on Zero based boards
#define Serial SERIAL_PORT_USBVIRTUAL
#endif


double dfreq;
const double refclk = 35780;  // tweak this number to get a good reference.  BAsically, test that you are getting 440 hz

volatile uint32_t phaccu;   // phase accumulator
volatile uint32_t tword_m;  // dds tuning word m
volatile byte counter;  //




void TC4_Handler()                                         // Interrupt Service Routine (ISR) for timer TC4
{
  // Check for overflow (OVF) interrupt
  if (TC4->COUNT16.INTFLAG.bit.OVF && TC4->COUNT16.INTENSET.bit.OVF)
  {
    // Put your timer overflow (OVF) code here....


    TC4->COUNT16.INTFLAG.reg = TC_INTFLAG_OVF;             // Clear the OVF interrupt flag
  }
}

/*
   High Frequency Interrupt
   This is the interrupt that controls the actual signal


*/

void TC5_Handler()                                         // Interrupt Service Routine (ISR) for timer TC4
{
  // Check for overflow (OVF) interrupt
  if (TC5->COUNT16.INTFLAG.bit.OVF && TC5->COUNT16.INTENSET.bit.OVF)
  {

    phaccu = phaccu + tword_m; // soft DDS, phase accu with 32 bits
    uint32_t icnt = phaccu >> 24;   // use upper 8 bits for phase accu as frequency information
    // read value fron ROM sine table and send to PWM DAC

    uint32_t value = pgm_read_byte_near(sine256 + icnt);

    // value = value << 1;


    analogWrite(A0, value);


    counter++;
    if (counter % 2 == 0) {
      digitalWrite(A2, true);
    } else {
      digitalWrite(A2, false);
    }



    TC5->COUNT16.INTFLAG.reg = TC_INTFLAG_OVF;             // Clear the OVF interrupt flag

  }
}

void setup() {

  Serial.begin(115200);
  Serial.println("Setting up");
  analogWriteResolution(10);
  dfreq = 440.0;                  // initial output frequency = 440 Hz
  tword_m = pow(2, 32) * dfreq / refclk; // calulate DDS new tuning word

  counter = 0;

  setupTimer4_5();

}

void loop() {

  Serial.println("Enter Loop:");
  while (true) { }
}
